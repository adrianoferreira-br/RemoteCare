/**************** Display  *******************************/
#include <Wire.h>                 // Only needed for Arduino 1.6.5 and earlier
#include "SSD1306Wire.h"          // legacy include: `#include "SSD1306.h"`
SSD1306Wire  display(0x3c, 5, 4); // Initialize the OLED display using Wire library
#define DEMO_DURATION 3000
typedef void (*Demo)(void);
int demoMode = 0;
int counter = 1;

#define logRemoteCare_width 128
  #define logRemoteCare_height 64
  static unsigned char logRemoteCare_bits[] = {
  0x00, 0x00, 0x00, 0x00, 0x00, 0x00, 0x00, 0x00, 0x00, 0x00, 0x00, 0x00, 
  0x00, 0x00, 0x00, 0x00, 0x00, 0x00, 0x00, 0x00, 0x00, 0x00, 0x00, 0x00, 
  0x00, 0x00, 0x00, 0x00, 0x00, 0x00, 0x00, 0x00, 0x00, 0x00, 0x00, 0x00, 
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  0x00, 0x00, 0x00, 0x00 };





void setupDisplayOLED() {

  

  
  // Initialising the UI will init the display too.
  display.init();

  display.flipScreenVertically();
  display.setFont(ArialMT_Plain_10);

}

void drawFontFaceDemo() {    
    // Font Demo1, create more fonts at http://oleddisplay.squix.ch/
    display.setTextAlignment(TEXT_ALIGN_LEFT);  
    display.setFont(ArialMT_Plain_24);
    display.drawString(25, 3, "Rafaela");
}

void drawTextFlowDemo() {
    display.setFont(ArialMT_Plain_10);
    display.setTextAlignment(TEXT_ALIGN_LEFT);
    display.drawStringMaxWidth(0, 0, 128,
      "Lorem ipsum\n dolor sit amet, consetetur sadipscing elitr, sed diam nonumy eirmod tempor invidunt ut labore." );
}

void drawTextToOled(String texto) {
    display.clear();
    display.setFont(ArialMT_Plain_10);
    display.setTextAlignment(TEXT_ALIGN_LEFT);
    display.drawStringMaxWidth(0, 0, 128, texto.c_str());
    display.display();  
}

void drawBigTextToOled(String texto) {
    display.clear();
    display.setFont(ArialMT_Plain_24);
    display.setTextAlignment(TEXT_ALIGN_CENTER);
    display.drawString(64, 22, texto.c_str());
    display.display();  
}

void drawTextAlignmentDemo() {
  // Text alignment demo
  display.setFont(ArialMT_Plain_10);
  // The coordinates define the left starting point of the text
  display.setTextAlignment(TEXT_ALIGN_LEFT);
  display.drawString(0, 10, "Left aligned (0,10)");
  // The coordinates define the center of the text
  display.setTextAlignment(TEXT_ALIGN_CENTER);
  display.drawString(64, 22, "Center aligned (64,22)");
  // The coordinates define the right end of the text
  display.setTextAlignment(TEXT_ALIGN_RIGHT);
  display.drawString(128, 33, "Right aligned (128,33)");
}

void drawRectDemo() {
      // Draw a pixel at given position
    for (int i = 0; i < 10; i++) {
      display.setPixel(i, i);
      display.setPixel(10 - i, i);
    }
    display.drawRect(12, 12, 20, 20);

    // Fill the rectangle
    display.fillRect(14, 14, 17, 17);

    // Draw a line horizontally
    display.drawHorizontalLine(0, 40, 20);

    // Draw a line horizontally
    display.drawVerticalLine(40, 0, 20);
}

void drawCircleDemo() {
  for (int i=1; i < 8; i++) {
    display.setColor(WHITE);
    display.drawCircle(32, 32, i*3);
    if (i % 2 == 0) {
      display.setColor(BLACK);
    }
    display.fillCircle(96, 32, 32 - i* 3);
  }
}

void drawProgressBarDemo() {
  int progress = (counter / 5) % 100;
  if (progress > 90){
    progress = 90;
    delay(50);
  }
  display.setFont(ArialMT_Plain_10);
  // draw the progress bar
  //display.drawProgressBar(0, 45, 120, 10, progress);
  display.drawProgressBar(0, 45, 120, 10, progress);

  // draw the percentage as String
  display.setTextAlignment(TEXT_ALIGN_CENTER);
  display.drawString(64, 30, String(progress) + "%");
}

void drawImageDemo() {
    // https://www.online-utility.org/image/convert/to/XBM converte para Xbm
    display.drawXbm(0, 0, logRemoteCare_width, logRemoteCare_height, logRemoteCare_bits);
}

//Demo demos[] = {drawFontFaceDemo, /*drawTextFlowDemo, drawTextAlignmentDemo, drawRectDemo, drawCircleDemo,*/ drawProgressBarDemo/*, drawImageDemo*/};
//int demoLength = (sizeof(demos) / sizeof(Demo));
long timeSinceLastModeSwitch = 0;

time_t lastDisplayUpdate = 0;

void setDelayToImage()
{
  //delay para mostrar imagem

   time(&lastDisplayUpdate);
  lastDisplayUpdate += 10;
}


bool showTime =false;

void loopDisplayOLED() {
  time_t rawtime;
  time(&rawtime);

  
  if(lastDisplayUpdate != 0 && (rawtime - lastDisplayUpdate) < 1)
  {
    return;
  }

  if(rawtime%5 == 0)
  {
      showTime =  !showTime;
    
  }
 // Serial.println("loopDisplayOLED");
  lastDisplayUpdate = rawtime;

  if(showTime)
    {
      char buffer[80];
      struct tm * timeinfo;
      timeinfo = localtime (&rawtime);
      strftime (buffer,80,"%H:%M",timeinfo);
  
      drawBigTextToOled(buffer);
      return;
    }

  
  
  // clear the display
  display.clear();
  // draw the current demo method
  ///demos[demoMode]();
  //drawFontFaceDemo();
  //drawProgressBarDemo();
  display.setTextAlignment(TEXT_ALIGN_RIGHT);
  display.drawString(10, 128, String(millis()));
  drawImageDemo();
  // write the buffer to the display
  display.display();

 /* if (millis() - timeSinceLastModeSwitch > DEMO_DURATION) {
    demoMode = (demoMode + 1)  % demoLength;
    timeSinceLastModeSwitch = millis();
  }*/
  counter++;
 
}
